## boards/shields/tastatur/Kconfig.defconfig
```kconfig
CONFIG_ZMK_POINTING=y
CONFIG_ZMK_POINTING_SMOOTH_SCROLLING=y
ZMK_STUDIO=y

if SHIELD_TASTATUR_LEFT
# Name must be less than 16 characters long!
config ZMK_KEYBOARD_NAME
    default "tastatur"

config ZMK_SPLIT_ROLE_CENTRAL
    default y
   
endif


if SHIELD_TASTATUR_LEFT || SHIELD_TASTATUR_RIGHT
config ZMK_SPLIT
    default y

endif
```

## boards/shields/tastatur/Kconfig.shield
```kconfig
# No whitespace after the comma or in your part name!
config SHIELD_TASTATUR_LEFT
    def_bool $(shields_list_contains,tastatur_l)


# No whitespace after the comma or in your part name!
config SHIELD_TASTATUR_RIGHT
    def_bool $(shields_list_contains,tastatur_r)
```
